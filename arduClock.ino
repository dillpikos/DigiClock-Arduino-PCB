//Arduino based digital clock PCB done using KiCad 9,RTC module and OLED display by BD
//Time is in PST(Pacific Standard Time)
//Digital clock also displays current Date
//Necessary Libraries
#include <Adafruit_GFX.h>
#include <Adafruit_SSD1306.h>
#include <RTClib.h>

#define SCREEN_WIDTH 128        //constant for screen width
#define SCREEN_HEIGHT 64        //constant for screen height
#define SCREEN_I2C_ADDRESS 0x3C //constant for screen address
#define OLED_RESET_PIN -1       //constant for reset button

Adafruit_SSD1306 screen(SCREEN_WIDTH, SCREEN_HEIGHT, &Wire, OLED_RESET_PIN); //creates object for display functionality while passing in necessary attributes
RTC_DS3231 realTimeClock; //creates object for rtc(real time clock) functionality

int year, //integer variables to hold necessary information for RTC module
      month,
      day,
      hour,
      minutes,
      seconds,
      convertedHour;

String AMorPM; //string variable which holds AM or PM

//Bitmaps generated using image2cpp to display icons on screen
const unsigned char concernedIcon[] PROGMEM = { //

  0x00, 0x00, 0x00, 0x00, 0x00, 0x00, 0x00, 0x00, 0x00, 0x00, 0x00, 0x00, 0x00, 0x00, 0x00, 0x00, 
	0x00, 0x00, 0x00, 0x00, 0x00, 0x00, 0x00, 0x00, 0x00, 0x03, 0x00, 0x00, 0x00, 0x00, 0x00, 0x00, 
	0x00, 0x03, 0x00, 0x00, 0x00, 0x00, 0x00, 0x40, 0x08, 0x03, 0x00, 0x00, 0x00, 0x00, 0x00, 0xc8, 
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	0x00, 0x00, 0x00, 0x00, 0x00, 0x00, 0x00, 0x00, 0x00, 0x00, 0x00, 0x00, 0x00, 0x00, 0x00, 0x00

};

const unsigned char noBatteryIcon[] PROGMEM = { //

  0x00, 0x00, 0x00, 0x00, 0x03, 0x00, 0x7f, 0xff, 0x80, 0x40, 0x1c, 0xc0, 0x40, 0x18, 0xc0, 0x40, 
	0x30, 0xf0, 0x40, 0x60, 0xf0, 0x40, 0xc0, 0xf0, 0x41, 0x80, 0xf0, 0x43, 0x00, 0xc0, 0x46, 0x00, 
	0xc0, 0x7f, 0xff, 0x80, 0x18, 0x00, 0x00, 0x10, 0x00, 0x00, 0x00, 0x00, 0x00, 0x00, 0x00, 0x00, 
	0x00, 0x00, 0x00, 0x00, 0x00, 0x00, 0x00, 0x00, 0x00, 0x00, 0x00, 0x00

};



void setup() {

  screen.begin(SSD1306_SWITCHCAPVCC,SCREEN_I2C_ADDRESS); //intializes screen
  realTimeClock.begin(); //initializes the real time clock module
  
  //realTimeClock.adjust(DateTime(2025,7,20,13,47,0)); //sets time of module to July 18,2025 and 12:13:15 PM [setting time is based on 24 hours system] (upload once then comment out so RTC module keeps track of time)

  if (realTimeClock.lostPower()){ //checks if external battery was removed and or dead at any point: this means time wasn't kept and current time is wrong
                                  //RTC.lostPower() flags it if true and stays that way until time and date are reset
    screen.clearDisplay();    

    screen.setTextSize(1);
    screen.setTextColor(WHITE);
    screen.setCursor(0, 10);
    screen.print("Battery was");
    screen.setCursor(10, 20);
    screen.print("removed!");
    screen.setCursor(0, 30);
    screen.print("Time & Date");
    screen.setCursor(2, 40);
    screen.print("need to be");
    screen.setCursor(17, 50);
    screen.print("reset!");

    //draws Icons on screen
    screen.drawBitmap(94,3,noBatteryIcon,20,20,WHITE); 
    screen.drawBitmap(69,14,concernedIcon,62,62,WHITE);

    screen.display();
    delay(10000); //display the message for 10 seconds each time device is powered


  }
  
} 

void loop() {

  getTime(); //Time function is called

  //Screen functions to display information

  screen.clearDisplay();                //clears display so it refereshes each time it loops
  screen.setTextSize(1);                //sets text size
  screen.setTextColor(WHITE);           //sets text color
  screen.setCursor(0,0);                //sets cursors postion on display to start inserting text

  //Border Lines
  screen.drawLine(0,0,128,0,WHITE);
  screen.drawLine(0,63,128,63,WHITE);
  screen.drawLine(0,0,0,64,WHITE);
  screen.drawLine(127,0,127,64,WHITE);

  //Time Section of Screen
  screen.setTextSize(2); 

  screen.setCursor(6,10);               
  screen.print(zeroAdder(convertedHour));   //prints information on screen while using zero adder function to add a zero in front if needed

  screen.setCursor(28,10);               
  screen.print(":");
  
  screen.setCursor(38, 10);
  screen.print(zeroAdder(minutes)); 

  screen.setCursor(60, 10);
  screen.print(":");

  screen.setCursor(70, 10);
  screen.print(zeroAdder(seconds));     

  //AM-PM section of screen
  screen.setCursor(100,13);              
  screen.setTextSize(1);                
  screen.print("[");
  screen.print(AMorPM);
  screen.print("]");

  screen.drawLine(0,32,128,32,WHITE); //middle border
  screen.drawLine(97,0,97,32,WHITE);

  //Date section of Screen
  screen.setCursor(6,41);               
  screen.setTextSize(2);               
  screen.print(zeroAdder(month));

  screen.drawLine(34,41,34,54,WHITE); //verticle line

  screen.setCursor(41,41);    
  screen.print(zeroAdder(day));

  screen.drawLine(70,41,70,54, WHITE);  //verticle line   

  screen.setCursor(76,41);   
  screen.print(year);   

  screen.display(); //displays all text on screen

}

//function that retrieves the current time and date
int getTime(){

  DateTime information = realTimeClock.now(); //retreives current time from rtc module and stores it into information object

  //retrieves and stores necessary imformation from information object using built in functions from RTC library
  year = information.year();
  month = information.month();
  day = information.day();
  hour = information.hour();
  minutes = information.minute();
  seconds = information.second();


  if(hour >= 12){ //if the current hour (based on 24 hour system is >=12) set the clock to PM
    AMorPM = "PM";

    if (hour > 12){ //converts the hour from the 24 hour system to a 12 the 12 hour system and stores it into variable
      convertedHour = (hour - 12);
    }

    else if(hour == 12){ //special case when the clock hits the 12'th hour meaning it's 12pm
      convertedHour = 12;
    }

  }

  else{ //if the current hour (based on 24 hour system) is < 12 set the clock to AM
    AMorPM = "AM";

    if (hour == 0){ //converts the 24 hour system of 0:00:00 to 12 hour system (12:00 AM)
      convertedHour = 12;
    }

    else{ //if given hour is in between 0 and 12 just leave it as is
      convertedHour = hour;
    }

  }

  return(year,month,day,convertedHour,minutes,seconds);

}

//function that adds a 0 infront of a number if less than 10 (purely for eligibilty and neatness)
int zeroAdder(int x){

  if (x < 10){ //if given number is < 10 it prints a zero on the same line as it
    screen.print("0");
  }
  return(x); //returns x with the 0 now in front

}

